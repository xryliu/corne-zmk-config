// action: =>
m_wd_a: macro_windows_dev_arrow {
    compatible = "zmk,behavior-macro";
    label = "m_wd_a";
    #binding-cells = <0>;
    wait-ms = <MC_WAIT_START>;
    bindings
        = <&none &kp LALT> /* ALT fix for VSCode */
        , <&macro_wait_time MC_WAIT>
        , <&kp EQUAL &kp GT>;
};

// action: ?░:░
m_wd_cto: macro_windows_conditional_ternary_operator {
    compatible = "zmk,behavior-macro";
    label = "m_wd_cto";
    #binding-cells = <0>;
    bindings
        = <&none>
        , <&macro_wait_time MC_WAIT>
        , <&kp QMARK &kp SPACE &kp SPACE &kp COLON &kp SPACE>
        , <&kp LEFT &kp LEFT &kp LEFT>;
};

// action: ?.
m_wd_oco: macro_windows_optional_chaining_operator {
    compatible = "zmk,behavior-macro";
    label = "m_wd_oco";
    #binding-cells = <0>;
    bindings
        = <&kp QMARK &kp DOT>;
};
