// tap:     '
// shift:   "
mp_wk_q: morph_windows_key_quote {
    compatible = "zmk,behavior-mod-morph";
    #binding-cells = <0>;
    mods = <(MOD_LSFT|MOD_RSFT)>;
    bindings = <&m_wi_s>, <&m_wi_d>;
};
