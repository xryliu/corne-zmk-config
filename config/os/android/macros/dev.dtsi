// action: ?░:░
m_ad_cto: macro_android_conditional_ternary_operator {
    compatible = "zmk,behavior-macro";
    label = "m_ad_cto";
    #binding-cells = <0>;
    bindings
        = <&none>
        , <&macro_wait_time MC_WAIT>
        , <&kp QMARK &kp SPACE &kp SPACE &kp COLON &kp SPACE>
        , <&kp LEFT &kp LEFT &kp LEFT>;
};

// action: ?.
m_ad_oco: macro_android_optional_chaining_operator {
    compatible = "zmk,behavior-macro";
    label = "m_ad_oco";
    #binding-cells = <0>;
    bindings
        = <&kp QMARK &kp DOT>;
};

// action: /* block comment */
m_ad_bc: macro_android_dev_block_comment {
    compatible = "zmk,behavior-macro";
    label = "m_ad_bc";
    #binding-cells = <0>;
    wait-ms = <MC_WAIT_START>;
    bindings
        = <&none &kp LALT> /* ALT fix for VSCode */
        , <&macro_wait_time MC_WAIT>
        , <&kp LC(LS(A))>;
};
