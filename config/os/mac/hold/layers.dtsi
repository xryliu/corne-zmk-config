to_mBAS_kp: behavior_to_mBAS_kp {
    compatible = "zmk,behavior-hold-tap";
    label = "to_mBAS_kp";
    #binding-cells = <2>;
    tapping-term-ms = <HP_TAPPING>;
    flavor = "hold-preferred";
    bindings = <&to_mBAS>, <&kp>;
};

MOTO_HOLD(w, AXN, BAS, FNK) //mo_mAXNwBAS_to_mFNK
MOTO_HOLD(w, AXN, BAS, AXN) //mo_mAXNwBAS_to_mAXN
MOTO_HOLD(w, DEV, BAS, DEV) //mo_mDEVwBAS_to_mDEV
MOTO_HOLD(w, AXN, DEV, BAS) //mo_mAXNwDEV_to_mBAS
MOTO_HOLD(w, AXN, DEV, AXN) //mo_mAXNwDEV_to_mAXN
MOTO_HOLD(w, FNK, AXN, FNK) //mo_mFNKwAXN_to_mFNK
