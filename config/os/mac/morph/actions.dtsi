// tap:     ⇺
// shift:   ⎗
mp_ma_prev: morph_mac_action_prev {
    compatible = "zmk,behavior-mod-morph";
    label = "mp_ma_prev";
    #binding-cells = <0>;
    mods = <(MOD_LSFT|MOD_RSFT)>;
    bindings = <&kp RC(PG_UP)>, <&kp LC(LG(LEFT))>;
};

// tap:     ⇻
// shift:   ⎘
mp_ma_next: morph_mac_action_next {
    compatible = "zmk,behavior-mod-morph";
    label = "mp_ma_next";
    #binding-cells = <0>;
    mods = <(MOD_LSFT|MOD_RSFT)>;
    bindings = <&kp RC(PG_DN)>, <&kp LC(LG(RIGHT))>;
};
